## boards/shields/Kconfig.defconfig
```kconfig
if SHIELD_DONGLE

# Max 16 characters in keyboard name
config ZMK_KEYBOARD_NAME
    default "Lily Dongle"

config ZMK_SPLIT_ROLE_CENTRAL
    default y

config ZMK_SPLIT
    default y

config ZMK_USB
	default y

config ZMK_BLE
	default y

config ZMK_SPLIT_BLE_CENTRAL_PERIPHERALS
    default 2

# Set this to ZMK_SPLIT_BLE_CENTRAL_PERIPHERALS + your desired number of BT profiles (default is 5)
config BT_MAX_CONN
    default 2

# Set this to the same number as BT_MAX_CONN
config BT_MAX_PAIRED
    default 2

endif #SHIELD_DONGLE
  

if SHIELD_LEFT || SHIELD_RIGHT

config ZMK_SPLIT
    default y

config ZMK_SPLIT_ROLE_PERIPHERAL
	default y

config ZMK_BLE
	default y

config ZMK_SPLIT_ROLE_CENTRAL
  default n
endif
```

## boards/shields/Kconfig.shield
```kconfig
config SHIELD_DONGLE
    def_bool $(shields_list_contains,dongle)

config SHIELD_LEFT
    def_bool $(shields_list_contains,splitkb_aurora_lily58_left)

config SHIELD_RIGHT
    def_bool $(shields_list_contains,actor_splitkb_aurora_lily58_right)
```
